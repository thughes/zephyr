## CMakeLists.txt
```
cmake_minimum_required(VERSION 3.20.0)
find_package(Zephyr REQUIRED HINTS $ENV{ZEPHYR_BASE})
project(reproduce_issue)

target_sources(app PRIVATE src/main.c)
```

## prj.conf
```kconfig
CONFIG_NETWORKING=y
CONFIG_WIFI=y
CONFIG_NET_L2_WIFI_MGMT=y
CONFIG_WIFI_CREDENTIALS=y
CONFIG_WIFI_CREDENTIALS_CONNECT_STORED=y
CONFIG_WIFI_CREDENTIALS_STATIC=y
CONFIG_WIFI_CREDENTIALS_STATIC_SSID="test"
CONFIG_WIFI_CREDENTIALS_STATIC_PASSWORD="test"
CONFIG_TEST=y
CONFIG_ZTEST=y
```

## src/main.c
```c
#include <zephyr/ztest.h>

ZTEST(reproduce_issue, test_dummy)
{
    zassert_true(true, "Dummy test");
}

ZTEST_SUITE(reproduce_issue, NULL, NULL, NULL, NULL, NULL);
```

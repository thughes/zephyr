## tests/kernel/stack_sentinel/testcase.yaml
```yaml
tests:
  kernel.stack.sentinel:
    tags:
      - kernel
    platform_allow:
      - native_sim
```

## tests/net/lib/lwm2m/pull_context/testcase.yaml
```yaml
tests:
  net.lwm2m.pull_context.over_read:
    tags: net lwm2m
    platform_allow: native_sim
```

## tests/reproduce_issue/testcase.yaml
```yaml
tests:
  reproduce.issue:
    tags: ignore_faults
    platform_allow: native_sim
```

## tests/subsys/fs/ext2_overflow/testcase.yaml
```yaml
common:
  tags: fs ext2
  platform_allow: native_sim
tests:
  fs.ext2.format.overflow:
    extra_configs:
      - CONFIG_ASAN=y
```

## tests/subsys/mgmt/ec_host_cmd/small_buffer/testcase.yaml
```yaml
tests:
  mgmt.ec_host_cmd.small_buffer:
    platform_allow:
      - native_sim
    integration_platforms:
      - native_sim
    tags: ec_host_cmd
```

## tests/subsys/mgmt/ec_host_cmd/validation/testcase.yaml
```yaml
common:
  tags: ec_host_cmd
  platform_allow: native_sim
tests:
  mgmt.ec_host_cmd.validation.small_tx:
    extra_configs:
      - CONFIG_EC_HOST_CMD_HANDLER_TX_BUFFER_SIZE=4
  mgmt.ec_host_cmd.validation.small_rx:
    extra_configs:
      - CONFIG_EC_HOST_CMD_HANDLER_RX_BUFFER_SIZE=4
```

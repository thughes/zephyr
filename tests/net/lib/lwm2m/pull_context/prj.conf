## CMakeLists.txt
```
# Copyright (c) 2025 Zephyr
# SPDX-License-Identifier: Apache-2.0

cmake_minimum_required(VERSION 3.20.0)
find_package(Zephyr REQUIRED HINTS $ENV{ZEPHYR_BASE})
project(lwm2m_pull_context_test)

zephyr_include_directories(${ZEPHYR_BASE}/subsys/net/lib/lwm2m)
target_sources(app PRIVATE src/main.c)
```

## prj.conf
```kconfig
CONFIG_ZTEST=y
CONFIG_NETWORKING=y
CONFIG_NET_TEST=y
CONFIG_LWM2M=y
CONFIG_LWM2M_FIRMWARE_UPDATE_OBJ_SUPPORT=y
CONFIG_LWM2M_FIRMWARE_UPDATE_PULL_SUPPORT=y
CONFIG_LWM2M_SWMGMT_OBJ_SUPPORT=y
CONFIG_LWM2M_SWMGMT_PACKAGE_URI_LEN=256
CONFIG_ASAN=y
CONFIG_MAIN_STACK_SIZE=4096
```

## src/main.c
```c
/*
 * Copyright (c) 2025 Zephyr
 *
 * SPDX-License-Identifier: Apache-2.0
 */

#include <zephyr/ztest.h>
#include <zephyr/net/lwm2m.h>
#include <stdlib.h>
#include "lwm2m_pull_context.h"
#include "lwm2m_engine.h"

static void result_cb(uint16_t obj_inst_id, int error_code)
{
    /* Expected failure due to invalid URI, but shouldn't crash */
    printk("Callback called with error %d\n", error_code);
}

static int write_cb(uint16_t obj_inst_id, uint16_t res_id, uint16_t res_inst_id,
		    uint8_t *data, uint16_t data_len, bool last_block,
		    size_t total_size, size_t offset)
{
    return 0;
}

static void test_lwm2m_pull_context_over_read(void)
{
    /* Allocate small buffer on heap */
    char *uri = malloc(10);
    zassert_not_null(uri, "Malloc failed");
    strcpy(uri, "short");

    struct requesting_object req = {
        .result_cb = result_cb,
        .write_cb = write_cb,
    };

    /* This should trigger ASAN heap-buffer-overflow (read) if bug is present. */
    /* With fix, it should run safely and call result_cb with error (parsing uri). */
    lwm2m_pull_context_start_transfer(uri, req, K_NO_WAIT);

    free(uri);
}

ZTEST_SUITE(lwm2m_pull_context, NULL, NULL, NULL, NULL, NULL);

ZTEST(lwm2m_pull_context, test_over_read)
{
    test_lwm2m_pull_context_over_read();
}
```

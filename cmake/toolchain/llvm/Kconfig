## cmake/toolchain/llvm/Kconfig
```kconfig
# Copyright (c) 2023 Intel Corporation
# SPDX-License-Identifier: Apache-2.0

# Change default linker to LLD. This must be placed before 'source' line.
# Note that we can't enable it in config file for program, because it breaks
# compilation with other toolchains.
choice LLVM_LINKER
	default LLVM_USE_LLD
endchoice

# The armv7m-cros-eabi compiler-rt was compiled with assumption that it will
# run on Cortex-M4 MCU with enabled FPU. It means that even with '-mfpu=none'
# option the floating point instructions will be used (because they are used in
# compiler-rt). Let's enable FPU always when compiling for ARMv7-M with FPU.
config FPU
	default y if ARMV7_M_ARMV8_M_FP

# LLVM toolchains for ARM use newlib as libc, indicate that it's supported.
# Original config (definied in 'lib/libc/Kconfig') depends on
# TOOLCHAIN_HAS_NEWLIB == y, which means that TOOLCHAIN_HAS_NEWLIB must be set
# before Kconfig files are processed. The only place that satisfies this
# requirement is ${ZEPHYR_BASE}/cmake/toolchain/llvm/generic.cmake, but due to
# HWMv2 we don't know the architecture at that point. The architecture is
# determined while processing Kconfig files, so let's indicate that Newlib is
# supported here.
config NEWLIB_LIBC_SUPPORTED
        bool
        #default y if ARM
        default y
        select FULL_LIBC_SUPPORTED

# Upstream settings

choice LLVM_LINKER
	prompt "LLVM Linker"
	depends on "${ZEPHYR_TOOLCHAIN_VARIANT}" = "llvm"
	default LLVM_USE_LD

config LLVM_USE_LD
	bool "GNU ld"
	help
	  Use binutils ld linker with llvm/clang.

config LLVM_USE_LLD
	bool "LLVM lld"
	help
	  Use LLVM built-in lld linker with llvm/clang.

endchoice

config TOOLCHAIN_LLVM_SUPPORTS_THREAD_LOCAL_STORAGE
	depends on RISCV || ARM || ARM64
	def_bool y
	select TOOLCHAIN_SUPPORTS_THREAD_LOCAL_STORAGE

config TOOLCHAIN_LLVM_SUPPORTS_GNU_EXTENSIONS
	def_bool y
	select TOOLCHAIN_SUPPORTS_GNU_EXTENSIONS
```
